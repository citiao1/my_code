/*---------------------------------------------------------------------*/
/* ------------------- Web: www.STCAI.com -----------------------------*/
/*---------------------------------------------------------------------*/

#include "AI8051U_Delay.h"

//========================================================================
// 函数: void delay_ms(unsigned int ms)
// 描述: 延时函数。
// 参数: ms,要延时的ms数, 这里只支持1~65535ms. 自动适应主时钟.
// 返回: none.
// 版本: VER1.0
// 日期: 2021-3-9
// 备注: 参考STC官方，比较精准且自适应主频
//========================================================================
void delay_ms(unsigned int ms)
{
	unsigned int i;
	do
	{
		i = MAIN_Fosc / 6000;
		while (--i)
			;
	} while (--ms);
}

//========================================================================
// 函数: void delay_us(unsigned int us)
// 描述: 延时函数。
// 参数: us,要延时的us数,改变时钟频率后，可更换do while内循环使得延时准确
// 版本: V1.0
// 日期: 2024-12-9
// 备注: 软件微秒延时  //@40MHz
//========================================================================
void delay_us(unsigned int us)
{
	unsigned long edata i;
	do
	{
		_nop_();
		_nop_();
		i = 8UL;
		while (i)
			i--;
	} while (us--);
}

//========================================================================
// 函数: void I2C_Delay(void)
// 描述: I2C延时函数.
// 参数: none.
// 返回: none.
// 版本: V1.0, 2020-09-15
//========================================================================
void I2C_Delay_2us(void)
{
	u8 dly;
	dly = MAIN_Fosc / 2000000UL; // 按2us计算
	while (--dly)
		;
}