#include "LQ_usart.h"


int fputc(int ch, FILE *stream)
{
        while( DL_UART_isBusy(UART_0_INST) == true );

        DL_UART_Main_transmitData(UART_0_INST, ch);

        return ch;
}
#if !defined(__MICROLIB)
//不使用微库的话就需要添加下面的函数
#if (__ARMCLIB_VERSION <= 6000000)
//如果编译器是AC5  就定义下面这个结构体
struct __FILE
{
        int handle;
};
#endif
FILE __stdout;
//定义_sys_exit()以避免使用半主机模式
void _sys_exit(int x)
{
        x = x;
}
#endif



/********************************************************************************************************************

 * @模块名称：串口 0
 
 * @使用方法：
 
		1. 初始化阶段：
            在程序开始运行的初始化阶段，调用 “ uart_init(); ” 函数。
 
        2. 接收与发送：
            详见该 .c 文件底部 “ UART_0_INST_IRQHandler(); ” 串口 0 对应的串口中断服务函数。

 ******************************************************************************************************************/




// 定义一个易变的无符号字符型变量 uart_data，用于存储串口接收到的数据
// 声明为 volatile 是为了确保编译器不会对该变量进行优化，保证在中断服务函数中能正确读写
volatile unsigned char uart_data = 0;

/********************************************************************************************************************
 * 【函数名称】 uart_init
 * 【功能概述】 该函数用于初始化串口，主要完成清除串口中断标志和使能串口中断的操作，为后续的串口通信做好准备。
 * 【输入参数】 无
 * 【返 回 值】 无
 * 【使用示例】 uart_init();  // 调用该函数进行串口初始化
 * 【注意事项】 该函数需要在使用串口通信前调用，以确保串口能正常响应中断。
 ******************************************************************************************************************/
void uart_init()
{
    // 清除串口中断标志，防止之前残留的中断标志影响后续操作
    NVIC_ClearPendingIRQ(UART_0_INST_INT_IRQN);
    // 使能串口中断，允许串口在接收到数据或发生其他事件时触发中断服务函数
    NVIC_EnableIRQ(UART_0_INST_INT_IRQN);
}

/********************************************************************************************************************
 * 【函数名称】 uart0_send_char
 * 【功能概述】 该函数用于通过串口 0 发送单个字符。在发送前会检查串口是否忙碌，若忙碌则等待，直到串口空闲后再发送字符。
 * 【输入参数】
 *            - char ch：需要发送的单个字符。
 * 【返 回 值】 无
 * 【使用示例】 uart0_send_char('A');  // 向串口 0 发送字符 'A'
 * 【注意事项】 该函数会阻塞当前线程，直到串口空闲并成功发送字符。
 ******************************************************************************************************************/
void uart0_send_char(char ch)
{
    // 当串口 0 忙的时候等待，确保在不忙的时候再发送传进来的字符
    while( DL_UART_isBusy(UART_0_INST) == true );
    // 发送单个字符
    DL_UART_Main_transmitData(UART_0_INST, ch);
}

/********************************************************************************************************************
 * 【函数名称】 uart0_send_string
 * 【功能概述】 该函数用于通过串口 0 发送字符串。它会逐个字符地发送字符串，直到字符串结束。
 * 【输入参数】
 *            - char* str：需要发送的字符串的首地址。
 * 【返 回 值】 无
 * 【使用示例】 uart0_send_string("Hello, World!");  // 向串口 0 发送字符串 "Hello, World!"
 * 【注意事项】 传入的字符串必须以 '\0' 结尾，否则会导致无限循环。
 ******************************************************************************************************************/
void uart0_send_string(char* str)
{
    // 当前字符串地址不在结尾 并且 字符串首地址不为空
    while(*str!= 0 && str!= 0)
    {
        // 发送字符串首地址中的字符，并且在发送完成之后首地址自增
        uart0_send_char(*str++);
    }
}



/********************************************************************************************************************
 * 【函数名称】 UART_0_INST_IRQHandler
 * 【功能概述】 该函数是串口的中断服务函数，当串口发生中断时会被调用。
 * 【输入参数】 无
 * 【返 回 值】 无
 * 【使用示例】 该函数由硬件中断自动调用，无需手动调用。
 * 【注意事项】 该函数应避免执行过长时间的操作，以免影响其他中断的响应。
 ******************************************************************************************************************/
void UART_0_INST_IRQHandler(void)
{
    // 如果产生了串口中断
    switch( DL_UART_getPendingInterrupt(UART_0_INST) )
    {
        case DL_UART_IIDX_RX: // 如果是接收中断
            // 将接收到的数据保存在变量中
            uart_data = DL_UART_Main_receiveData(UART_0_INST);
            // 将保存的数据再发送出去
            uart0_send_char(uart_data);
            break;

        default: // 其他的串口中断
            break;
    }
}



