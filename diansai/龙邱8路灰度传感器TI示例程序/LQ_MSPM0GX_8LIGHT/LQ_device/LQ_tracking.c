#include "LQ_tracking.h"





/********************************************************************************************************************

 * @模块名称：8 路模拟量灰度循迹模块

 * @模块概述：
 
    本模块主要用于实现 8 路模拟量灰度循迹功能，通过对 8 个不同通道的模拟量进行采集和处理，
		能够感知外部环境的灰度变化，常用于智能小车等设备的循迹应用场景。


 * @使用方法：
 
    1. 初始化阶段：
       在程序开始运行的初始化阶段，调用 “ Tracking_Adc_Init(); ” 函数。							// （该函数的作用是对模块所需的硬件资源（ADC）进行初始化配置，为后续的数据采集操作做好准备。）
			 
    2. 数据采集阶段：
       在主函数的 while(1) 循环中调用 “ Tracking_Value_Acquire(); ” 函数。						// （此函数会触发 8 路模拟量的采集过程，从各个通道获取当前的模拟量数据，并进行必要的处理和转换。）
			 
    3. 数据访问阶段：
       采集到的数据会存储在数组 “ LQ_Tracking_Value[] ” 中。可以直接访问 “ LQ_Tracking_Value[0] - LQ_Tracking_Value[7] ”  // （这些数组元素分别对应循迹模块从左至右各个通道的 ADC 数据。）
			 


 * @注意事项：
 
    使用方法中未涉及的函数或变量主要供内部调用。非必要情况下，用户无需深入了解其实现细节，只需按照上述使用方法进行操作即可。
		若确实需要对模块进行定制或优化，建议在充分了解模块整体架构和硬件原理的基础上进行。

 ******************************************************************************************************************/





//-----------------8 路模拟量灰度循迹模块最终数据-----------------
unsigned char LQ_Tracking_Value[8] = {0};


/********************************************************************************************************************
 * 【函数名称】 Tracking_Adc_Init
 * 【功能概述】 8 路模拟量灰度循迹模块初始化函数
 * 【输入参数】 无
 * 【返 回 值】 无
 * 【使用示例】 Tracking_Adc_Init();
 * 【注意事项】 此操作将启用与 8 路模拟量灰度循迹模块相关的 ADC 中断。
 *              通过 NVIC_EnableIRQ 函数，允许 ADC 在完成转换等特定事件发生时触发中断，
 *              以便系统能够及时响应 ADC 转换结果，为后续采集数据做好准备。
 ******************************************************************************************************************/
void Tracking_Adc_Init()
{
		// 开启ADC中断
    NVIC_EnableIRQ(ADC_Tracking_INST_INT_IRQN);
}


/********************************************************************************************************************
 * 【函数名称】 Tracking_IO_Set
 * 【功能概述】 该函数用于控制 8 路模拟量灰度循迹模块的三个 IO 引脚的电平状态，通过设置这些引脚的电平组合，
 *             可以决定循迹模块 ADC 引脚输出哪个通道的数据。
 * 【输入参数】
 *            - unsigned char S2：代表循迹模块 S2 引脚的电平状态。
 *            - unsigned char S1：代表循迹模块 S1 引脚的电平状态。
 *            - unsigned char S0：代表循迹模块 S0 引脚的电平状态。
 * 【返 回 值】 无
 * 【使用示例】 Tracking_IO_Set(0, 0, 1);  // 将 S2 设为低电平，S1 设为低电平，S0 设为高电平，选择通道 2
 * 【注意事项】 每个参数可输入 0 或 1，其中 0 表示将对应引脚设置为低电平，1 表示将对应引脚设置为高电平。
 *             不同的电平组合对应不同的循迹模块通道选择。具体对应关系如下：
 *            - (S2, S1, S0) = (0, 0, 0) 对应通道 1
 *            - (S2, S1, S0) = (0, 0, 1) 对应通道 2
 *            - (S2, S1, S0) = (0, 1, 0) 对应通道 3
 *            - (S2, S1, S0) = (0, 1, 1) 对应通道 4
 *            - (S2, S1, S0) = (1, 0, 0) 对应通道 5
 *            - (S2, S1, S0) = (1, 0, 1) 对应通道 6
 *            - (S2, S1, S0) = (1, 1, 0) 对应通道 7
 *            - (S2, S1, S0) = (1, 1, 1) 对应通道 8
 ******************************************************************************************************************/
void Tracking_IO_Set(unsigned char S2, unsigned char S1, unsigned char S0)
{
    // 根据 S2 的输入值设置 S2 引脚电平
    if (S2 == 0)
        Tracking_S2_LOW;
    if (S2 == 1)
        Tracking_S2_HIGH;

    // 根据 S1 的输入值设置 S1 引脚电平
    if (S1 == 0)
        Tracking_S1_LOW;
    if (S1 == 1)
        Tracking_S1_HIGH;

    // 根据 S0 的输入值设置 S0 引脚电平
    if (S0 == 0)
        Tracking_S0_LOW;
    if (S0 == 1)
        Tracking_S0_HIGH;
}


//-----------------ADC 采集成功标志位-----------------
volatile bool Tracking_Adc_Check = 0;


/********************************************************************************************************************
 * 【函数名称】 Tracking_Adc_once
 * 【功能概述】 单次 ADC 采集函数，该函数用于执行一次 ADC（模拟 - 数字转换）采集操作，
 *             从相关的模拟信号源获取一个数字值，代表当前模拟信号的幅度。
 * 【输入参数】 无
 * 【返 回 值】 unsigned int，返回本次 ADC 采集得到的数据
 * 【使用示例】 unsigned int Adc_Result = Tracking_Adc_once();
 * 【注意事项】 无
 ******************************************************************************************************************/
unsigned int Tracking_Adc_once(void)
{
		unsigned int Adc_Result = 0;

		// 软件触发 ADC 开始转换
		DL_ADC12_startConversion(ADC_Tracking_INST);
	
		// 如果当前状态为正在转换中则等待转换结束
		while (false == Tracking_Adc_Check) __WFE();

		// 获取数据
		Adc_Result = DL_ADC12_getMemResult(ADC_Tracking_INST, ADC_Tracking_ADCMEM_ADC0_CH0);

		// 清除标志位
		Tracking_Adc_Check = false;

		return Adc_Result;
}


/********************************************************************************************************************
 * 【函数名称】 Tracking_ADC_IRQHandler
 * 【功能概述】 循迹模块 ADC 中断服务函数
 * 【输入参数】 无
 * 【返 回 值】 无
 * 【使用示例】 无
 * 【注意事项】 初始化开启 ADC 中断后自动调用
 ******************************************************************************************************************/
void ADC_Tracking_INST_IRQHandler(void)
{
		// 查询并清除ADC中断
		switch (DL_ADC12_getPendingInterrupt(ADC_Tracking_INST))
		{
			
				// 检查是否完成数据采集
				case DL_ADC12_IIDX_MEM0_RESULT_LOADED:
				{
						// 将标志位置 1
						Tracking_Adc_Check = true;
						break;
				}
				
				default:
					
				break;
		}
}


/********************************************************************************************************************
 * 【函数名称】 Tracking_Value_once
 * 【功能概述】 该函数用于获取循迹模块单通道的 ADC 数据。在获取过程中，会对数据进行一系列处理，
 *             包括防串扰、简单的均值滤波以及缩放操作，最终输出处理后的 ADC 数据。
 * 【输入参数】 unsigned char ch，循迹模块的 ADC 通道编号，取值范围应为 1 - 8。
 * 【返 回 值】 unsigned int，返回该 ADC 通道经过处理后的数据，数据范围为 0 - 100。
 * 【使用示例】 unsigned int value = Tracking_Value_once(1);  // 调用函数获取循迹模块第 1 通道的 ADC 数据
 * 【注意事项】 函数自带防串扰、简单的均值滤波以及缩放功能。其中，缩放操作会将原始的 0 - 4095 数据范围转换为 0 - 100。
 *             为了避免初始不稳定采样值（串扰）的影响，会抛弃前几次采样数据。
 ******************************************************************************************************************/
unsigned int Tracking_Value_once(unsigned char ch)
{
    // 定义变量用于存储每次采样得到的原始 ADC 数据
    unsigned int data = 0;
    // 定义变量用于累加有效的采样数据，以便后续进行均值计算
    unsigned int sum = 0;
    // 定义变量用于存储最终经过处理后要输出的 ADC 数据
    unsigned int value_out = 0;
    // 定义采样次数，即对该通道进行 ADC 采样的总次数
    unsigned char num_samples = 5;
    // 定义要抛弃的前几次采样次数，用于避免通道串扰的影响
    unsigned char discard_samples = 3;

    // 循环进行多次采样，以实现均值滤波
    for (unsigned char i = 0; i < num_samples; i++)
    {
        // 根据传入的通道编号 ch，设置循迹模块相应的输出通道。
        if (ch == 1)
            Tracking_IO_Set(0, 0, 0);  // 设置为第 1 通道
        if (ch == 2)
            Tracking_IO_Set(0, 0, 1);  // 设置为第 2 通道
        if (ch == 3)
            Tracking_IO_Set(0, 1, 0);  // 设置为第 3 通道
        if (ch == 4)
            Tracking_IO_Set(0, 1, 1);  // 设置为第 4 通道
        if (ch == 5)
            Tracking_IO_Set(1, 0, 0);  // 设置为第 5 通道
        if (ch == 6)
            Tracking_IO_Set(1, 0, 1);  // 设置为第 6 通道
        if (ch == 7)
            Tracking_IO_Set(1, 1, 0);  // 设置为第 7 通道
        if (ch == 8)
            Tracking_IO_Set(1, 1, 1);  // 设置为第 8 通道

        // 调用 Tracking_Adc_once 函数获取当前通道的原始 ADC 数据，并进行缩放处理
        // 原始数据范围是 0 - 4095，缩放后范围变为 0 - 100
        data = Tracking_Adc_once() * 0.02442;
				// 对 data 限幅，确保变量的值在 0 - 100 这个范围内
				data = data >= 100 ? 100 : (data <= 0 ? 0 : data);

        // 抛弃前 discard_samples 次采样数据，避免初始不稳定采样值的影响
        // 只累加有效的采样数据到 sum 中
        if (i >= discard_samples)
            sum += data;
    }

    // 计算有效采样数据的平均值，得到最终要输出的 ADC 数据
    value_out = sum / (num_samples - discard_samples);

    // 返回最终经过处理后的 ADC 数据
    return (unsigned int)value_out;
}



/********************************************************************************************************************
 * 【函数名称】 Tracking_Value_Acquire
 * 【功能概述】 该函数用于获取 8 路模拟量灰度循迹模块各通道的 ADC 数据。它会调用相应函数获取每个通道的原始 ADC 数据，
 *             并将其存储在特定数组中，同时数据会进行缩放处理。
 * 【输入参数】 无
 * 【返 回 值】 无
 * 【使用示例】 Tracking_Value_Acquire();  // 调用该函数获取 8 路模拟量灰度循迹模块各通道的 ADC 数据
 * 【注意事项】 函数获取的原始 ADC 数据范围为 0 - 4095，经过缩放后，最终存储在数组中的数据取值范围为 0 - 100。
 *             可以直接通过访问 LQ_Tracking_Value[i]（i 取值范围为 0 - 7）来获取各通道缩放后的数据。
 ******************************************************************************************************************/
void Tracking_Value_Acquire()
{
    // 定义循环变量，用于遍历 8 个通道
    unsigned char i = 0;

    // 循环 8 次，依次获取 8 路模拟量灰度循迹模块各通道的 ADC 数据
    for (i = 0; i < 8; i++)
    {
        // 调用 Tracking_Value_once 函数获取第 i+1 个通道的 ADC 数据
        // 并将获取到的数据存储到 LQ_Tracking_Value 数组的第 i 个位置
        LQ_Tracking_Value[i] = Tracking_Value_once(i + 1);
    }
}



/********************************************************************************************************************
 * 【函数名称】 LQ_Test_Tracking
 * 【功能概述】 本函数用于对 8 路模拟量灰度循迹模块进行测试。通过持续获取该模块各通道的 ADC 数据，
 *             并将这些数据显示在 OLED 屏幕上，从而方便开发人员进行调试和观察。
 * 【输入参数】 无
 * 【返 回 值】 无
 * 【使用示例】 LQ_Test_Tracking();
 * 【注意事项】 无
 ******************************************************************************************************************/
void LQ_Test_Tracking()
{
		// 8 路灰度循迹模块初始化
		Tracking_Adc_Init();
	
		// 初始化OLED
		OLED_Init();
	
		while(1)
		{
				// 获取 8 路模拟量灰度循迹模块各通道 ADC 数据
				Tracking_Value_Acquire();
				

				// 屏幕显示
				sprintf(txt, "LQ_Test_Tracking");
				OLED_ShowString(0, 18, (uint8_t *)txt, 12);

				// LQ_Tracking_Value[0] - LQ_Tracking_Value[7] 表示循迹模块从左至右各个通道的 ADC 数据
				sprintf(txt, "a1: %04d   a2: %04d", LQ_Tracking_Value[0], LQ_Tracking_Value[1]);
				OLED_ShowString(3, 0, (uint8_t *)txt, 8);
				sprintf(txt, "a3: %04d   a4: %04d", LQ_Tracking_Value[2], LQ_Tracking_Value[3]);
				OLED_ShowString(4, 0, (uint8_t *)txt, 8);
				sprintf(txt, "a5: %04d   a6: %04d", LQ_Tracking_Value[4], LQ_Tracking_Value[5]);
				OLED_ShowString(5, 0, (uint8_t *)txt, 8);
				sprintf(txt, "a7: %04d   a8: %04d", LQ_Tracking_Value[6], LQ_Tracking_Value[7]);
				OLED_ShowString(6, 0, (uint8_t *)txt, 8);

				OLED_Refresh();
				
		}
}






