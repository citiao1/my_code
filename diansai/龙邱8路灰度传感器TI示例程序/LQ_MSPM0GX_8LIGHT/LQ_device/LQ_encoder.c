#include "LQ_encoder.h"




/********************************************************************************************************************

 * @模块名称：A/B 相编码器    或    A/Dir 带方向编码器

 * @模块概述：
 
    本模块主要用于获取编码器的旋转速度，通过编码器 A 相的外部中断和定时器中断完成采集，常用于智能小车的测速应用场景。


 * @使用方法：
 
    1. 初始化阶段：
       在程序开始运行的初始化阶段，调用 “ Encoder_Init(); ” 函数。
			 
		2. 数据采集阶段：（不需要做任何动作）
			 编码器 A 相的外部中断和特定的定时器中断将会自行运行，采集到的数据会直接自动存储在变量 “ LQ_encoder_L 和 LQ_encoder_R ” 中。
			 
    3. 数据访问阶段：
       直接访问变量 “ LQ_encoder_L 和 LQ_encoder_R ”即可。
			 


 * @注意事项：
 
    使用方法中未涉及的函数或变量主要供内部调用。非必要情况下，用户无需深入了解其实现细节，只需按照上述使用方法进行操作即可。
		若确实需要对模块进行定制或优化，建议在充分了解模块整体架构和硬件原理的基础上进行。

 ******************************************************************************************************************/





/********************************************************************************************************************
 * 【变量名称】 LQ_encoder_L、LQ_encoder_R
 * 【功能概述】 用于存储左右编码器的最终数据，反映编码器的瞬时速度。该数据在定时器中断服务函数中更新。
 * 【使用示例】 通过读取这两个变量的值获取左右编码器的瞬时速度数据
 * 【注意事项】 变量值在定时器中断中更新，更新周期为定时器配置周期
 ******************************************************************************************************************/
int LQ_encoder_L = 0, LQ_encoder_R = 0;

/********************************************************************************************************************
 * 【变量名称】 LQ_encoder_L_Last、LQ_encoder_R_Last
 * 【功能概述】 左右编码器的临时数据，用于在外部中断中累计编码器的脉冲值。
 * 【使用示例】 在外部中断中对其进行递增或递减操作，定时器中断中用于更新最终数据
 * 【注意事项】 定时器中断会将其清零，以重新累计下一个周期的脉冲值
 ******************************************************************************************************************/
int LQ_encoder_L_Last = 0, LQ_encoder_R_Last = 0;





/********************************************************************************************************************
 * 【函数名称】 Encoder_Init
 * 【功能概述】 编码器初始化函数，开启编码器引脚的端口中断和定时器中断，并清除定时器中断标志。
 * 【输入参数】 无
 * 【返 回 值】 无
 * 【使用示例】 Encoder_Init();
 * 【注意事项】 此操作将启用编码器引脚的端口中断和定时器中断。通过 NVIC_EnableIRQ 函数允许相关中断，
 *             同时使用 NVIC_ClearPendingIRQ 清除定时器中断标志，为后续编码器数据采集做好准备。
 ******************************************************************************************************************/
void Encoder_Init()
{
	// 开启编码器引脚的端口中断
	NVIC_EnableIRQ(Encoder_INT_IRQN);
	// 清除定时器中断标志
	NVIC_ClearPendingIRQ(TIMER_0_INST_INT_IRQN);
	// 使能定时器中断
	NVIC_EnableIRQ(TIMER_0_INST_INT_IRQN);
}



/********************************************************************************************************************
 * 【函数名称】 GROUP1_IRQHandler
 * 【功能概述】 Group1 的中断服务函数，用于处理编码器的外部中断，根据编码器的 A、B 相引脚状态累计脉冲值。
 * 【输入参数】 无
 * 【返 回 值】 无
 * 【使用示例】 当任意编码器 A 相引脚触发中断时自动调用
 * 【注意事项】 根据编码器 A、B 相引脚的电平状态判断旋转方向，进行脉冲值的递增或递减操作。
 *             处理完中断后，需要清除相应的中断状态。
 ******************************************************************************************************************/
void GROUP1_IRQHandler(void)  // Group1 的中断服务函数
{
		static int GPIO_Interrup_flag = 0;
	
		// 获取编码器 A 相引脚的中断状态
		GPIO_Interrup_flag = DL_GPIO_getEnabledInterruptStatus(Encoder_L_A_PORT, Encoder_L_A_PIN|Encoder_R_A_PIN);
		
		// 处理左编码器
		if( (GPIO_Interrup_flag & Encoder_L_A_PIN) == Encoder_L_A_PIN )  // 判断左编码器 A 相引脚是否触发中断
		{
				if( DL_GPIO_readPins(Encoder_L_B_PORT, Encoder_L_B_PIN) == 0)  // 判断左编码器旋转方向
				{
						LQ_encoder_L_Last++;  // 正向旋转，脉冲值递增
				}
				else
				{
						LQ_encoder_L_Last--;  // 反向旋转，脉冲值递减
				}
		}
		// 处理右编码器
		if( (GPIO_Interrup_flag & Encoder_R_A_PIN) == Encoder_R_A_PIN )  // 判断右编码器 A 相引脚是否触发中断
		{
				if( DL_GPIO_readPins(Encoder_R_B_PORT, Encoder_R_B_PIN) == 0)  // 判断右编码器旋转方向
				{
						LQ_encoder_R_Last--;  // 正向旋转，脉冲值递减
				}
				else
				{
						LQ_encoder_R_Last++;  // 反向旋转，脉冲值递增
				}
		}
		
		// 清除编码器 A 相引脚的中断状态
		DL_GPIO_clearInterruptStatus(Encoder_L_A_PORT, Encoder_L_A_PIN|Encoder_R_A_PIN);
}



/********************************************************************************************************************
 * 【函数名称】 TIMER_0_INST_IRQHandler
 * 【功能概述】 定时器的中断服务函数，已配置为 5ms 的周期，用于更新编码器的最终数据并清零临时数据。
 * 【输入参数】 无
 * 【返 回 值】 无
 * 【使用示例】 定时器每 5ms 触发一次该中断服务函数
 * 【注意事项】 定时器中断触发后，将临时数据赋值给最终数据，并将临时数据清零，以重新累计下一个周期的脉冲值。
 ******************************************************************************************************************/
void TIMER_0_INST_IRQHandler(void)
{
		// 如果产生了定时器中断
		if( DL_TimerG_getPendingInterrupt(TIMER_0_INST) == DL_TIMER_IIDX_ZERO )
		{
			
			// 得到编码器瞬时速度，将临时数据赋值给最终数据
			LQ_encoder_L = LQ_encoder_L_Last;
			LQ_encoder_R = LQ_encoder_R_Last;
			// 清零临时数据，准备下一个周期的脉冲累计
			LQ_encoder_L_Last = 0;
			LQ_encoder_R_Last = 0;
			
		}
}



/********************************************************************************************************************
 * 【函数名称】 LQ_Test_Encoder
 * 【功能概述】 编码器测试函数，初始化 OLED 和编码器，在循环中显示编码器数据并刷新 OLED 显示。
 * 【输入参数】 无
 * 【返 回 值】 无
 * 【使用示例】 LQ_Test_Encoder();
 * 【注意事项】 此函数会进入一个无限循环，不断显示编码器数据。
 ******************************************************************************************************************/
void LQ_Test_Encoder(void)
{
        OLED_Init();  // 初始化OLED
		
        Encoder_Init();  // 编码器初始化
		
        while(1)
        {	
            sprintf(txt, "LQ_Test_Encoder ");
            OLED_ShowString(0, 20, (uint8_t *)txt, 12);

            sprintf(txt, "encoder_L: %5d ", LQ_encoder_L);
            OLED_ShowString(3, 0, (uint8_t *)txt, 8);
				
            sprintf(txt, "encoder_R: %5d ", LQ_encoder_R);
            OLED_ShowString(5, 0, (uint8_t *)txt, 8);
			
            OLED_Refresh();
			
            delay_ms(5);
        }
	
}
