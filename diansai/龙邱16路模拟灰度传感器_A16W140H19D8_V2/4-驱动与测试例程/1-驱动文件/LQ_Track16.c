#include "LQ_Track16.h"
#include "lq_include.h"

/********************************************************************************************************************

 * @模块名称：8/16 路模拟量灰度循迹模块
 * @模块概述：
    本模块主要用于实现 8/16 路模拟量灰度循迹功能，通过对 16 个不同通道的模拟量进行采集和处理，
        能够感知外部环境的灰度变化，常用于智能小车等设备的循迹应用场景。
 * @使用方法：
    1. 初始化阶段：
       在程序开始运行的初始化阶段，调用 “ Tracking_Adc_Init(); ” 函数。
       // （该函数的作用是对模块所需的硬件资源（ADC）进行初始化配置，为后续的数据采集操作做好准备。）
    2. 数据采集阶段：
       在主函数的 while(1) 循环中调用 “ Tracking_Value_Acquire(); ” 函数。
       // （此函数会触发 8/16 路模拟量的采集过程，从各个通道获取当前的模拟量数据，并进行必要的处理和转换。）
    3. 数据访问阶段：
       采集到的数据会存储在数组 “ LQ_Tracking_Value[] ” 中。可以直接访问 “ LQ_Tracking_Value[0] - LQ_Tracking_Value[15] ” 中的数据，以获取各个通道的模拟量值。
       例如，访问 “ LQ_Tracking_Value[0] ” 获取第一个通道的模拟量值，
       // （这些数组元素分别对应循迹模块从左至右各个通道的 ADC 数据。）
 * @注意事项：
    使用方法中未涉及的函数或变量主要供内部调用。非必要情况下，用户无需深入了解其实现细节，只需按照上述使用方法进行操作即可。
        若确实需要对模块进行定制或优化，建议在充分了解模块整体架构和硬件原理的基础上进行。
 ******************************************************************************************************************/

//-----------------16 路模拟量灰度循迹模块最终数据-----------------
unsigned int LQ_Tracking_Value[TRACK_CHANNEL_NUM] = {0};

/********************************************************************************************************
 * 【函数名称】 Tracking_init
 * 【功能概述】 该函数用于初始化 16 路模拟量灰度循迹模块所需的硬件资源，包括 GPIO 引脚和 ADC 模块。通过调用相应的初始化函数，
 *            配置引脚为输出模式以选择不同的通道，并设置 ADC 的采样频率，为后续的数据采集做好准备。
 * 【输入参数】 无
 * 【返 回 值】 无
 * 【使用示例】 Tracking_init();  // 调用该函数初始化 16 路模拟量灰度循迹模块的硬件资源
 * 【注意事项】 在调用该函数之前，请确保已经正确连接了 16 路模拟量灰度循迹模块的引脚，并根据你的 MCU 的 GPIO 初始化函数对引脚进行配置。 
 *******************************************************************************************************/
void LQ_Tracking_init()
{
    PIN_InitConfig(TRACK_S0_PIN, PIN_MODE_OUTPUT, 1); // 初始化 TRACK_S0_PIN 引脚为输出模式，用于选择循迹模块的通道
    PIN_InitConfig(TRACK_S1_PIN, PIN_MODE_OUTPUT, 1);
    PIN_InitConfig(TRACK_S2_PIN, PIN_MODE_OUTPUT, 1);
    PIN_InitConfig(TRACK_S3_PIN, PIN_MODE_OUTPUT, 1);
    ADC_InitConfig(ADC8, 80000);
}

/********************************************************************************************************************
 * 【函数名称】 Tracking_Value_once
 * 【功能概述】 该函数用于获取循迹模块单通道的 ADC 数据。在获取过程中，会对数据进行一系列处理，
 *             包括防串扰、简单的均值滤波以及缩放操作，最终输出处理后的 ADC 数据。
 * 【输入参数】 unsigned char ch，循迹模块的 ADC 通道编号，取值范围应为 1 - 16
 *            不同的电平组合对应不同的循迹模块通道选择。具体对应关系如下：
 *            - (S3, S2, S1, S0) = (0, 0, 0, 0) 对应通道 1  --> S3|S2|S1|S0 = 0000B = 0
 *            - (S3, S2, S1, S0) = (0, 0, 0, 1) 对应通道 2  --> S3|S2|S1|S0 = 0001B = 1
 *            ***...（其他通道以此类推）
 *            - (S3, S2, S1, S0) = (1, 0, 0, 0) 对应通道 9
 *            ***...（其他通道以此类推）
 *            - (S3, S2, S1, S0) = (1, 1, 1, 1) 对应通道 16
 *            因此， S3、S2、S1、S0 电平状态组合成的二进制数（0-15）选择要采集的通道（1-16）。
 * 【返 回 值】 unsigned int，返回该 ADC 通道经过处理后的数据，数据范围为 0 - 100。
 * 【使用示例】 unsigned int value = Tracking_Value_once(1);  // 调用函数获取循迹模块第 1 通道的 ADC 数据
 * 【注意事项】 函数自带防串扰、简单的均值滤波以及缩放功能。其中，缩放操作会将原始的 0 - 4095 数据范围转换为 0 - 100。
 *             为了避免初始不稳定采样值（串扰）的影响，会抛弃前几次采样数据。
 ******************************************************************************************************************/
unsigned int Tracking_Value_once(unsigned char ch)
{
    unsigned int data = 0;             // 定义变量用于存储每次采样得到的原始 ADC 数据
    unsigned int sum = 0;              // 定义变量用于累加有效的采样数据，以便后续进行均值计算
    unsigned int value_out = 0;        // 定义变量用于存储最终经过处理后要输出的 ADC 数据
    unsigned char num_samples = 5;     // 定义采样次数，即对该通道进行 ADC 采样的总次数
    unsigned char discard_samples = 3; // 定义要抛弃的前几次采样次数，用于避免通道串扰的影响

    // 循环进行多次采样，以实现均值滤波
    for (unsigned char i = 0; i < num_samples; i++)
    {
        // 通过位运算直接计算引脚电平状态（通道值0-15对应4位二进制）
        PIN_Write(TRACK_S3_PIN, (ch >> 3) & 0x01); // 取最高位(S3)
        PIN_Write(TRACK_S2_PIN, (ch >> 2) & 0x01); // 次高位(S2)
        PIN_Write(TRACK_S1_PIN, (ch >> 1) & 0x01); // 次低位(S1)
        PIN_Write(TRACK_S0_PIN, ch & 0x01);        // 最低位(S0)

        // 调用 Tracking_Adc_once 函数获取当前通道的原始 ADC 数据，并进行缩放处理
        // 原始数据范围是 0 - 4095，缩放后范围变为 0 - 100
        data = ADC_Read(ADC8) * 0.02442;
        // 对 data 限幅，确保变量的值在 0 - 100 这个范围内
        data = data >= 100 ? 100 : (data <= 0 ? 0 : data);

        // 抛弃前 discard_samples 次采样数据，避免初始不稳定采样值的影响
        // 只累加有效的采样数据到 sum 中
        if (i >= discard_samples)
            sum += data;
    }

    // 计算有效采样数据的平均值，得到最终要输出的 ADC 数据
    value_out = sum / (num_samples - discard_samples);

    // 返回最终经过处理后的 ADC 数据
    return (unsigned int)value_out;
}

/********************************************************************************************************************
 * 【函数名称】 Tracking_Value_Acquire
 * 【功能概述】 该函数用于获取 16 路模拟量灰度循迹模块各通道的 ADC 数据。它会调用相应函数获取每个通道的原始 ADC 数据，
 *             并将其存储在特定数组中，同时数据会进行缩放处理。
 * 【输入参数】 无
 * 【返 回 值】 无
 * 【使用示例】 Tracking_Value_Acquire();  // 调用该函数获取 16 路模拟量灰度循迹模块各通道的 ADC 数据
 * 【注意事项】 函数获取的原始 ADC 数据范围为 0 - 4095，经过缩放后，最终存储在数组中的数据取值范围为 0 - 100。
 *             可以直接通过访问 LQ_Tracking_Value[i]（i 取值范围为 0 - 15）来获取各通道缩放后的数据。
 ******************************************************************************************************************/
void Tracking_Value_Acquire()
{
    // 定义循环变量，用于遍历 16 个通道
    unsigned char i = 0;

    // 循环 16 次，依次获取 16 路模拟量灰度循迹模块各通道的 ADC 数据
    for (i = 0; i < 16; i++)
    {
        // 调用 Tracking_Value_once 函数获取第 i+1 个通道的 ADC 数据
        LQ_Tracking_Value[i] = Tracking_Value_once(i);
    }
}

/********************************************************************************************************************
 * 【函数名称】 Test_LQ_Tracking
 * 【功能概述】 本函数用于对 16 路模拟量灰度循迹模块进行测试。通过持续获取该模块各通道的 ADC 数据，
 *             并将这些数据显示在 lcd屏幕上，从而方便开发人员进行调试和观察。
 * 【输入参数】 无
 * 【返 回 值】 无
 * 【使用示例】 Test_LQ_Tracking();
 * 【注意事项】 注意你的LCD屏初始化函数和显示函数的使用方法，确保它们能够正确显示文本内容。
 *             该函数会持续运行并不断更新屏幕上的数据，因此在测试过程中请确保有适当的退出机制或重置设备的方法。
 ******************************************************************************************************************/
void Test_LQ_Tracking()
{
    char txt[32];
    GPIO_LED_Init();
    Display_Init(0);        // LCD初始化
    Display_CLS(U16_BLACK); // 黑色屏幕
    LQ_Tracking_init();
    while (1)
    {
        // 获取 16 路模拟量灰度循迹模块各通道 ADC 数据CH[0,15]
        Tracking_Value_Acquire(); // 调用函数获取所有通道的 ADC 数据，并存储在 LQ_Tracking_Value 数组中
        for (size_t i = 0; i < TRACK_CHANNEL_NUM; i++)
        {
            if( i%2 == 0)  // 偶数通道显示在屏幕上半部分，奇数通道显示在屏幕下半部分
            {
                sprintf((char *)txt, "   A%02d:%03d  ", i, LQ_Tracking_Value[i]);
                Display_showString(0, i+1, txt, U16_WHITE, U16_BLACK, 12);
            }
            else
            {
                sprintf((char *)txt, "   A%02d:%03d  ", i, LQ_Tracking_Value[i]);
                Display_showString(64, i, txt, U16_WHITE, U16_BLACK, 12);
            }
        }
    }
}

